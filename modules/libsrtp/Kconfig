## modules/libsrtp/Kconfig
```kconfig
# Copyright (c) 2025 Sayed Naser Moravej <seyednasermoravej@gmail.com>
# SPDX-License-Identifier: Apache-2.0

config LIBSRTP
	bool "libsrtp support"
	depends on MBEDTLS

	help
	  Enable libsrtp library integration as a Zephyr module.
```
