## Kconfig
```
# Copyright (c) 2025 Sayed Naser Moravej <seyednasermoravej@gmail.com>
# SPDX-License-Identifier: Apache-2.0

mainmenu "RTPW Sample Application"

config NET_SAMPLE_SRTP_KEY
	string "SRTP master key for RTPW example."
	default "c1eec3717da76195bb878578790af71c4ee9f859e197a414a78d5abc7451"
	help
	  This key in hexadecimal which is used by the application. You can override it in prj.conf
	  or via menuconfig / guiconfig.

choice
	prompt "Program mode"
	default NET_SAMPLE_RECEIVER
	help
	  Select whether this application runs as sender or receiver.

config NET_SAMPLE_SENDER
	bool "Sender mode"
	help
	  Build the application as an RTP sender.

config NET_SAMPLE_RECEIVER
	bool "Receiver mode"
	help
	  Build the application as an RTP receiver.

endchoice

config NET_SAMPLE_SRTP_SERVER_PORT
	int "SRTP port"
	default 9999
	help
	  SRTP port that the application sends or receives over that port.

source "Kconfig.zephyr"
```

## prj.conf
```kconfig
#network
CONFIG_NETWORKING=y
CONFIG_NET_IPV4=y
CONFIG_NET_IPV6=n
CONFIG_NET_ARP=y
CONFIG_NET_CONFIG_SETTINGS=y
CONFIG_NET_CONFIG_MY_IPV4_ADDR="192.0.2.2"
CONFIG_NET_CONFIG_MY_IPV4_NETMASK="255.255.255.0"
CONFIG_NET_L2_ETHERNET=y
CONFIG_NET_UDP=y
CONFIG_NET_MGMT=y
CONFIG_NET_MGMT_EVENT_STACK_SIZE=1024
CONFIG_NET_MGMT_EVENT=y
CONFIG_NET_SOCKETS=y
CONFIG_ENTROPY_GENERATOR=y
CONFIG_POSIX_API=y
CONFIG_POSIX_DEVICE_IO=y

# Console
CONFIG_SERIAL=y

# Crypto (mbedTLS)
CONFIG_MBEDTLS=y
CONFIG_MBEDTLS_PSA_CRYPTO_C=y
CONFIG_MBEDTLS_ENABLE_HEAP=y
CONFIG_MBEDTLS_HEAP_SIZE=16384
CONFIG_MBEDTLS_SHA1=y

CONFIG_PSA_WANT_KEY_TYPE_AES=y
CONFIG_PSA_WANT_ALG_CTR=y
CONFIG_PSA_WANT_ALG_HMAC=y

# LibSRTP
CONFIG_LIBSRTP=y

CONFIG_MAIN_STACK_SIZE=4096
CONFIG_LOG_MODE_IMMEDIATE=y

# Logging
CONFIG_LOG=y
CONFIG_LOG_DEFAULT_LEVEL=3
```

## overlay-sender.conf
```kconfig
CONFIG_NET_CONFIG_PEER_IPV4_ADDR="192.0.2.1"
```

## src/main.c
```c
/*
 * Copyright 2025 Sayed Naser Moravej <seyednasermoravej@gmail.com>
 *
 * SPDX-License-Identifier: Apache-2.0
 */

#include <zephyr/kernel.h>
#include <zephyr/posix/unistd.h>
#include <zephyr/posix/arpa/inet.h>
#include <zephyr/logging/log.h>
#include <zephyr/net/net_ip.h>

#include <config.h>
#include "srtp.h"
#include <zephyr/kernel.h>
#include <zephyr/net/socket.h>

#include "srtp_priv.h"
#include "cipher_priv.h"

#include <zephyr/net/socket.h>

#include <zephyr/logging/log.h>
LOG_MODULE_REGISTER(rtpw_sample, LOG_LEVEL_INF);

/*
 * RTP_HEADER_LEN indicates the size of an RTP header
 */
#define RTP_HEADER_LEN 12

/*
 * RTP_MAX_BUF_LEN defines the largest RTP packet
 */
#define RTP_MAX_BUF_LEN 1500

typedef struct {
    srtp_hdr_t header;
    char body[RTP_MAX_BUF_LEN];
} rtp_msg_t;

typedef struct rtp_ctx_t {
    int socket_fd;
    rtp_msg_t message;
    struct k_mutex lock;
    srtp_ctx_t *srtp_ctx;
    struct sockaddr_in addr; /* reciever's address */

#ifdef CONFIG_NET_SAMPLE_SENDER
	uint16_t seq_host;
    uint32_t ts_host;
#endif
} rtp_ctx_t;

srtp_err_status_t rtp_init(rtp_ctx_t *rtp,
                                  int sock_fd,
                                  struct sockaddr_in addr,
                                  uint32_t ssrc)
{
#ifdef CONFIG_NET_SAMPLE_SENDER
    /* Host-order sequence/timestamp */
    rtp->seq_host = (uint16_t)srtp_cipher_rand_u32_for_tests();
    rtp->ts_host  = 0;

    /* Initialize RTP header */
    rtp->message.header.ts  = sys_cpu_to_be32(rtp->ts_host);
    rtp->message.header.seq = sys_cpu_to_be16(rtp->seq_host);
#elif defined(CONFIG_NET_SAMPLE_RECEIVER)

    rtp->message.header.seq = 0;
    rtp->message.header.ts = 0;
#endif
    rtp->message.header.ssrc = sys_cpu_to_be32(ssrc);
    rtp->message.header.m = 0;
    rtp->message.header.pt = 0x1;
    rtp->message.header.version = 2;
    rtp->message.header.p = 0;
    rtp->message.header.x = 0;
    rtp->message.header.cc = 0;

    /* set other stuff */
    rtp->socket_fd = sock_fd;
    rtp->addr = addr;

    return srtp_err_status_ok;
}

#ifdef CONFIG_NET_SAMPLE_SENDER
ssize_t rtp_sendto(rtp_ctx_t *sender, const void *msg, size_t len);
static inline void rtp_update_header(rtp_ctx_t *sender)
{
    k_mutex_lock(&sender->lock, K_FOREVER);

    sender->seq_host++;
    sender->ts_host++;

    sender->message.header.seq = sys_cpu_to_be16(sender->seq_host);
    sender->message.header.ts  = sys_cpu_to_be32(sender->ts_host);

    k_mutex_unlock(&sender->lock);
}

ssize_t rtp_sendto(rtp_ctx_t *sender, const void *msg, size_t len)
{
    size_t octets_sent;
    srtp_err_status_t stat;
    size_t msg_len = len + RTP_HEADER_LEN;
    size_t pkt_len = RTP_HEADER_LEN + RTP_MAX_BUF_LEN;

    /* marshal data */
    memcpy(sender->message.body, msg, len);

    /* update header */
	rtp_update_header(sender);

    /* apply srtp */
    stat =
        srtp_protect(sender->srtp_ctx, (uint8_t *)&sender->message.header,
                     msg_len, (uint8_t *)&sender->message.header, &pkt_len, 0);
    if (stat) {
        LOG_ERR("error: srtp protection failed with code %d\n", stat);
        return -1;
    }
    octets_sent =
        zsock_sendto(sender->socket_fd, (void *)&sender->message, pkt_len, 0,
               (struct sockaddr *)&sender->addr, sizeof(struct sockaddr_in));

    if (octets_sent != pkt_len) {
        LOG_ERR("error: couldn't send message %s", (char *)msg);
    }

    return octets_sent;
}

#else

ssize_t rtp_recvfrom(rtp_ctx_t *receiver, void *msg, size_t *len)
{
    ssize_t ret;
    size_t octets_recvd;
    srtp_err_status_t stat;

    ret = zsock_recvfrom(receiver->socket_fd, (void *)&receiver->message, *len, 0,
                   (struct sockaddr *)NULL, 0);

    if (ret < 0) {
        *len = 0;
        return -1;
    }

    octets_recvd = ret;

    /* verify rtp header */
    if (receiver->message.header.version != 2) {
        *len = 0;
        return -1;
    }

    LOG_DBG("%zu octets received from SSRC %u\n", octets_recvd,
            receiver->message.header.ssrc);

    /* apply srtp */
    stat = srtp_unprotect(receiver->srtp_ctx,
                          (uint8_t *)&receiver->message.header, octets_recvd,
                          (uint8_t *)&receiver->message.header, &octets_recvd);
    if (stat) {
        LOG_ERR("error: srtp unprotection failed with code %d%s\n",
                stat,
                stat == srtp_err_status_replay_fail ? " (replay check failed)"
                : stat == srtp_err_status_auth_fail ? " (auth check failed)"
                                                    : "");
        return -1;
    }
    strncpy(msg, receiver->message.body, octets_recvd);

    return octets_recvd;
}

#endif

#define MAX_WORD_LEN 128
#define MAX_KEY_LEN  96


int main(void)
{
	char word[MAX_WORD_LEN];
	int sock_fd, ret;
	struct in_addr rcvr_addr;
	struct sockaddr_in name;
	char key[MAX_KEY_LEN];
	srtp_policy_t policy;
	srtp_err_status_t status;
	uint32_t ssrc = 0xdeadbeefu; /* ssrc value hardcoded for now */

	memset(&policy, 0x0, sizeof(srtp_policy_t));

	LOG_INF("Using %s [0x%x]\n", srtp_get_version_string(), srtp_get_version());

	/* initialize srtp library */
	status = srtp_init();
	if (status) {
		LOG_ERR("srtp initialization failed with error code %d.", status);
		return 0;
	}

	/* set address */
	LOG_INF("peer IPv4 address: %s.", CONFIG_NET_CONFIG_PEER_IPV4_ADDR);
	LOG_INF("my IPv4 address: %s.", CONFIG_NET_CONFIG_MY_IPV4_ADDR);

	if (inet_pton(AF_INET, CONFIG_NET_CONFIG_PEER_IPV4_ADDR, &rcvr_addr) != 1) {
		LOG_ERR("Invalid IPv4 address: %s.", CONFIG_NET_CONFIG_PEER_IPV4_ADDR);
		return 0;
	}

	/* open socket */
	sock_fd = zsock_socket(PF_INET, SOCK_DGRAM, IPPROTO_UDP);
	if (sock_fd < 0) {
		LOG_ERR("couldn't open socket.");
		return 0;
	}

	memset(&name, 0, sizeof(struct sockaddr_in));
	name.sin_addr = rcvr_addr;
	name.sin_family = PF_INET;
	name.sin_port = htons(CONFIG_NET_SAMPLE_SRTP_SERVER_PORT);

	/* set up the srtp policy and master key
	 * create policy structure, using the default mechanisms.
	 */
	srtp_crypto_policy_set_rtp_default(&policy.rtp);
	srtp_crypto_policy_set_rtcp_default(&policy.rtcp);
	policy.ssrc.type = ssrc_specific;
	policy.ssrc.value = ssrc;
	policy.key = (uint8_t *)key;
	policy.next = NULL;
	policy.window_size = 128;
	policy.allow_repeat_tx = 0;
	policy.rtp.sec_serv = sec_serv_conf_and_auth;
	policy.rtcp.sec_serv = sec_serv_none; /* we don't do RTCP anyway */
	size_t key_len = hex2bin(CONFIG_NET_SAMPLE_SRTP_KEY, strlen(CONFIG_NET_SAMPLE_SRTP_KEY),
				 key, sizeof(key));

	/* check that hex string is the right length */
	if (key_len != policy.rtp.cipher_key_len) {
		LOG_ERR("wrong number of digits in key (should be %d digits, found %d).",
			2 * policy.rtp.cipher_key_len, 2 * key_len);
		return 0;
	}

	/* initialize sender's rtp and srtp contexts */
	rtp_ctx_t rtp = { 0 };

	rtp_init(&rtp, sock_fd, name, ssrc);
	status = srtp_create(&rtp.srtp_ctx, &policy);
	if (status) {
		LOG_ERR("srtp_create() failed with code %d.", status);
		return 0;
	}

#ifdef CONFIG_NET_SAMPLE_SENDER

	size_t word_len;
	/* Up-count the buffer, then send them off */
	for (int i = 0; i < 1000; i++) {
		snprintf(word, sizeof(word), "SRTP test%d.", i);
		word_len = strlen(word) + 1; /* plus one for null */

		if (word_len > MAX_WORD_LEN) {
			LOG_ERR("word %s too large to send.", word);
		} else {
			rtp_sendto(&rtp, word, word_len);
			LOG_INF("sending word: %s", word);
		}
		k_msleep(500);
	}


#elif defined(CONFIG_NET_SAMPLE_RECEIVER)

	if (zsock_bind(sock_fd, (struct sockaddr *)&name, sizeof(name)) < 0) {
		zsock_close(sock_fd);
		LOG_ERR("socket bind error.");
		return 0;
	}

	/* get next word and loop */
	while (true) {
		size_t word_len = MAX_WORD_LEN;

		if (rtp_recvfrom(&rtp, word, &word_len) > -1) {
			LOG_INF("receiving word: %s", word);
		}
	}
#else
#error "Either SENDER or RECEIVER should be defined."
#endif
	srtp_dealloc(rtp.srtp_ctx);
	ret = zsock_close(sock_fd);
	if (ret < 0) {
		LOG_ERR("Failed to close socket");
	}

	status = srtp_shutdown();
	if (status) {
		LOG_ERR("srtp shutdown failed with error code %d.", status);
		return 0;
	}
	return 0;
}
```
